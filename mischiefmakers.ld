SECTIONS
{
    __romPos = 0;
    _gp = 0x0;
    header_ROM_START = __romPos;
    header_VRAM = ADDR(.header);
    .header : AT(header_ROM_START) SUBALIGN(16)
    {
        FILL(0x00000000);
        header_DATA_START = .;
        header = .;
        build\asm\header.o(.data);
        header_DATA_END = .;
        header_DATA_SIZE = ABSOLUTE(header_DATA_END - header_DATA_START);
    }
    __romPos += SIZEOF(.header);
    header_ROM_END = __romPos;
    header_VRAM_END = .;

    boot_ROM_START = __romPos;
    boot_VRAM = ADDR(.boot);
    .boot : AT(boot_ROM_START) SUBALIGN(16)
    {
        FILL(0x00000000);
        boot_DATA_START = .;
        boot = .;
        build\assets\boot.o(.data);
        boot_DATA_END = .;
        boot_DATA_SIZE = ABSOLUTE(boot_DATA_END - boot_DATA_START);
    }
    __romPos += SIZEOF(.boot);
    boot_ROM_END = __romPos;
    boot_VRAM_END = .;

    entry_ROM_START = __romPos;
    entry_VRAM = ADDR(.entry);
    .entry 0x80000400 : AT(entry_ROM_START) SUBALIGN(16)
    {
        FILL(0x00000000);
        entry_TEXT_START = .;
        build\asm\1000.o(.text);
        . = ALIGN(., 16);
        entry_TEXT_END = .;
        entry_TEXT_SIZE = ABSOLUTE(entry_TEXT_END - entry_TEXT_START);
        entry_DATA_START = .;
        _1000 = .;
        build\asm\1000.o(.data);
        . = ALIGN(., 16);
        entry_DATA_END = .;
        entry_DATA_SIZE = ABSOLUTE(entry_DATA_END - entry_DATA_START);
        entry_RODATA_START = .;
        build\asm\1000.o(.rodata);
        . = ALIGN(., 16);
        entry_RODATA_END = .;
        entry_RODATA_SIZE = ABSOLUTE(entry_RODATA_END - entry_RODATA_START);
    }
    entry_bss_VRAM = ADDR(.entry_bss);
    .entry_bss (NOLOAD) : SUBALIGN(16)
    {
        FILL(0x00000000);
        entry_BSS_START = .;
        build\asm\1000.o(.bss);
        . = ALIGN(., 16);
        entry_BSS_END = .;
        entry_BSS_SIZE = ABSOLUTE(entry_BSS_END - entry_BSS_START);
    }
    __romPos += SIZEOF(.entry);
    __romPos = ALIGN(__romPos, 16);
    . = ALIGN(., 16);
    entry_ROM_END = __romPos;
    entry_VRAM_END = .;

    main_ROM_START = __romPos;
    main_VRAM = ADDR(.main);
    .main entry_VRAM_END : AT(main_ROM_START) SUBALIGN(16)
    {
        FILL(0x00000000);
        main_TEXT_START = .;
        build\asm\1050.o(.text);
        build\asm\5A70.o(.text);
        build\asm\A540.o(.text);
        build\asm\11820.o(.text);
        build\asm\12DD0.o(.text);
        build\asm\134E0.o(.text);
        build\asm\13850.o(.text);
        build\asm\156F0.o(.text);
        build\asm\17A70.o(.text);
        build\asm\1E7A0.o(.text);
        build\asm\1F1E0.o(.text);
        build\asm\22290.o(.text);
        build\asm\241E0.o(.text);
        build\asm\438E0.o(.text);
        build\asm\48A30.o(.text);
        build\asm\49200.o(.text);
        build\asm\4FEB0.o(.text);
        build\asm\59EA0.o(.text);
        build\asm\5D120.o(.text);
        build\asm\5E230.o(.text);
        build\asm\60CF0.o(.text);
        build\asm\61B80.o(.text);
        build\asm\66250.o(.text);
        build\asm\7D8E0.o(.text);
        build\asm\805E0.o(.text);
        build\asm\80D90.o(.text);
        build\asm\82920.o(.text);
        build\asm\82DB0.o(.text);
        build\asm\82F80.o(.text);
        build\asm\844E0.o(.text);
        build\asm\84BB0.o(.text);
        build\asm\8D0A0.o(.text);
        build\asm\8F080.o(.text);
        build\asm\97770.o(.text);
        build\asm\99750.o(.text);
        build\asm\99A70.o(.text);
        build\asm\99B50.o(.text);
        build\asm\9A3C0.o(.text);
        build\asm\9A820.o(.text);
        build\asm\9A8F0.o(.text);
        build\asm\9AC20.o(.text);
        build\asm\9B060.o(.text);
        build\asm\9B250.o(.text);
        build\asm\9B2F0.o(.text);
        build\asm\9B5B0.o(.text);
        build\asm\9B680.o(.text);
        build\asm\9BAA0.o(.text);
        build\asm\9BAD0.o(.text);
        build\asm\9C5D0.o(.text);
        build\asm\9C620.o(.text);
        build\asm\9C730.o(.text);
        build\asm\9C880.o(.text);
        build\asm\9C8E0.o(.text);
        build\asm\9CD50.o(.text);
        build\asm\9D020.o(.text);
        build\asm\9EEA0.o(.text);
        build\asm\9EEF0.o(.text);
        build\asm\9F0D0.o(.text);
        build\asm\9F140.o(.text);
        build\asm\9FA70.o(.text);
        build\asm\9FA90.o(.text);
        build\asm\A09A0.o(.text);
        build\asm\A09F0.o(.text);
        build\asm\A0B40.o(.text);
        build\asm\A0BF0.o(.text);
        build\asm\A0C60.o(.text);
        build\asm\A4D70.o(.text);
        build\asm\A4DB0.o(.text);
        build\asm\A4E80.o(.text);
        build\asm\A51F0.o(.text);
        build\asm\A5270.o(.text);
        build\asm\A53C0.o(.text);
        build\asm\A5510.o(.text);
        build\asm\A5810.o(.text);
        build\asm\A59F0.o(.text);
        build\asm\A5AA0.o(.text);
        build\asm\A5D10.o(.text);
        build\asm\A5DD0.o(.text);
        build\asm\A6240.o(.text);
        build\asm\A6310.o(.text);
        build\asm\A6320.o(.text);
        build\asm\A63F0.o(.text);
        build\asm\A6830.o(.text);
        build\asm\A6930.o(.text);
        build\asm\A6A90.o(.text);
        build\asm\A6AD0.o(.text);
        build\asm\A79B0.o(.text);
        build\asm\A7A80.o(.text);
        build\asm\A7B10.o(.text);
        build\asm\A7B90.o(.text);
        build\asm\A7C10.o(.text);
        build\asm\A7C70.o(.text);
        build\asm\A7D50.o(.text);
        build\asm\A7E10.o(.text);
        build\asm\A8410.o(.text);
        build\asm\A8440.o(.text);
        build\asm\A8460.o(.text);
        build\asm\A87F0.o(.text);
        build\asm\A8900.o(.text);
        build\asm\A8A20.o(.text);
        build\asm\A8B00.o(.text);
        build\asm\A8CE0.o(.text);
        build\asm\A9080.o(.text);
        build\asm\A9550.o(.text);
        build\asm\A9860.o(.text);
        build\asm\A9A10.o(.text);
        build\asm\A9D20.o(.text);
        build\asm\AA700.o(.text);
        build\asm\AB380.o(.text);
        build\asm\AB440.o(.text);
        build\asm\AB520.o(.text);
        build\asm\AB610.o(.text);
        build\asm\AB990.o(.text);
        build\asm\ABB00.o(.text);
        build\asm\ABC50.o(.text);
        build\asm\ABE20.o(.text);
        build\asm\ABE30.o(.text);
        build\asm\ABE50.o(.text);
        build\asm\AE340.o(.text);
        build\asm\AE7D0.o(.text);
        build\asm\AE8A0.o(.text);
        build\asm\AE9A0.o(.text);
        build\asm\AEA90.o(.text);
        build\asm\AEB70.o(.text);
        build\asm\AEED0.o(.text);
        build\asm\AEF70.o(.text);
        build\asm\AF0C0.o(.text);
        build\asm\AF1A0.o(.text);
        build\asm\AF2A0.o(.text);
        build\asm\AFEE0.o(.text);
        build\asm\B0110.o(.text);
        build\asm\B2BF0.o(.text);
        build\asm\B2DD0.o(.text);
        build\asm\B2E20.o(.text);
        build\asm\B3340.o(.text);
        build\asm\B3660.o(.text);
        build\asm\B39A0.o(.text);
        build\asm\B3BE0.o(.text);
        build\asm\B3E60.o(.text);
        build\asm\B5510.o(.text);
        build\asm\B5600.o(.text);
        build\asm\B56B0.o(.text);
        build\asm\B6010.o(.text);
        build\asm\B6130.o(.text);
        build\asm\B6180.o(.text);
        build\asm\B61F0.o(.text);
        build\asm\B62A0.o(.text);
        build\asm\B6380.o(.text);
        build\asm\B63E0.o(.text);
        build\asm\B6440.o(.text);
        build\asm\B6500.o(.text);
        build\asm\B6590.o(.text);
        build\asm\B7280.o(.text);
        build\asm\B7DF0.o(.text);
        build\asm\B7E10.o(.text);
        build\asm\B8850.o(.text);
        build\asm\B8900.o(.text);
        build\asm\B9B90.o(.text);
        build\asm\B9EC0.o(.text);
        build\asm\BB260.o(.text);
        build\asm\BB310.o(.text);
        build\asm\BB3F0.o(.text);
        build\asm\BB5E0.o(.text);
        . = ALIGN(., 16);
        main_TEXT_END = .;
        main_TEXT_SIZE = ABSOLUTE(main_TEXT_END - main_TEXT_START);
        main_DATA_START = .;
        _1050 = .;
        build\asm\1050.o(.data);
        _5A70 = .;
        build\asm\5A70.o(.data);
        A540 = .;
        build\asm\A540.o(.data);
        _11820 = .;
        build\asm\11820.o(.data);
        _12DD0 = .;
        build\asm\12DD0.o(.data);
        _134E0 = .;
        build\asm\134E0.o(.data);
        _13850 = .;
        build\asm\13850.o(.data);
        _156F0 = .;
        build\asm\156F0.o(.data);
        _17A70 = .;
        build\asm\17A70.o(.data);
        _1E7A0 = .;
        build\asm\1E7A0.o(.data);
        _1F1E0 = .;
        build\asm\1F1E0.o(.data);
        _22290 = .;
        build\asm\22290.o(.data);
        _241E0 = .;
        build\asm\241E0.o(.data);
        _438E0 = .;
        build\asm\438E0.o(.data);
        _48A30 = .;
        build\asm\48A30.o(.data);
        _49200 = .;
        build\asm\49200.o(.data);
        _4FEB0 = .;
        build\asm\4FEB0.o(.data);
        _59EA0 = .;
        build\asm\59EA0.o(.data);
        _5D120 = .;
        build\asm\5D120.o(.data);
        _5E230 = .;
        build\asm\5E230.o(.data);
        _60CF0 = .;
        build\asm\60CF0.o(.data);
        _61B80 = .;
        build\asm\61B80.o(.data);
        _66250 = .;
        build\asm\66250.o(.data);
        _7D8E0 = .;
        build\asm\7D8E0.o(.data);
        _805E0 = .;
        build\asm\805E0.o(.data);
        _80D90 = .;
        build\asm\80D90.o(.data);
        _82920 = .;
        build\asm\82920.o(.data);
        _82DB0 = .;
        build\asm\82DB0.o(.data);
        _82F80 = .;
        build\asm\82F80.o(.data);
        _844E0 = .;
        build\asm\844E0.o(.data);
        _84BB0 = .;
        build\asm\84BB0.o(.data);
        _8D0A0 = .;
        build\asm\8D0A0.o(.data);
        _8F080 = .;
        build\asm\8F080.o(.data);
        _97770 = .;
        build\asm\97770.o(.data);
        _99750 = .;
        build\asm\99750.o(.data);
        _99A70 = .;
        build\asm\99A70.o(.data);
        _99B50 = .;
        build\asm\99B50.o(.data);
        _9A3C0 = .;
        build\asm\9A3C0.o(.data);
        _9A820 = .;
        build\asm\9A820.o(.data);
        _9A8F0 = .;
        build\asm\9A8F0.o(.data);
        _9AC20 = .;
        build\asm\9AC20.o(.data);
        _9B060 = .;
        build\asm\9B060.o(.data);
        _9B250 = .;
        build\asm\9B250.o(.data);
        _9B2F0 = .;
        build\asm\9B2F0.o(.data);
        _9B5B0 = .;
        build\asm\9B5B0.o(.data);
        _9B680 = .;
        build\asm\9B680.o(.data);
        _9BAA0 = .;
        build\asm\9BAA0.o(.data);
        _9BAD0 = .;
        build\asm\9BAD0.o(.data);
        _9C5D0 = .;
        build\asm\9C5D0.o(.data);
        _9C620 = .;
        build\asm\9C620.o(.data);
        _9C730 = .;
        build\asm\9C730.o(.data);
        _9C880 = .;
        build\asm\9C880.o(.data);
        _9C8E0 = .;
        build\asm\9C8E0.o(.data);
        _9CD50 = .;
        build\asm\9CD50.o(.data);
        _9D020 = .;
        build\asm\9D020.o(.data);
        _9EEA0 = .;
        build\asm\9EEA0.o(.data);
        _9EEF0 = .;
        build\asm\9EEF0.o(.data);
        _9F0D0 = .;
        build\asm\9F0D0.o(.data);
        _9F140 = .;
        build\asm\9F140.o(.data);
        _9FA70 = .;
        build\asm\9FA70.o(.data);
        _9FA90 = .;
        build\asm\9FA90.o(.data);
        A09A0 = .;
        build\asm\A09A0.o(.data);
        A09F0 = .;
        build\asm\A09F0.o(.data);
        A0B40 = .;
        build\asm\A0B40.o(.data);
        A0BF0 = .;
        build\asm\A0BF0.o(.data);
        A0C60 = .;
        build\asm\A0C60.o(.data);
        A4D70 = .;
        build\asm\A4D70.o(.data);
        A4DB0 = .;
        build\asm\A4DB0.o(.data);
        A4E80 = .;
        build\asm\A4E80.o(.data);
        A51F0 = .;
        build\asm\A51F0.o(.data);
        A5270 = .;
        build\asm\A5270.o(.data);
        A53C0 = .;
        build\asm\A53C0.o(.data);
        A5510 = .;
        build\asm\A5510.o(.data);
        A5810 = .;
        build\asm\A5810.o(.data);
        A59F0 = .;
        build\asm\A59F0.o(.data);
        A5AA0 = .;
        build\asm\A5AA0.o(.data);
        A5D10 = .;
        build\asm\A5D10.o(.data);
        A5DD0 = .;
        build\asm\A5DD0.o(.data);
        A6240 = .;
        build\asm\A6240.o(.data);
        A6310 = .;
        build\asm\A6310.o(.data);
        A6320 = .;
        build\asm\A6320.o(.data);
        A63F0 = .;
        build\asm\A63F0.o(.data);
        A6830 = .;
        build\asm\A6830.o(.data);
        A6930 = .;
        build\asm\A6930.o(.data);
        A6A90 = .;
        build\asm\A6A90.o(.data);
        A6AD0 = .;
        build\asm\A6AD0.o(.data);
        A79B0 = .;
        build\asm\A79B0.o(.data);
        A7A80 = .;
        build\asm\A7A80.o(.data);
        A7B10 = .;
        build\asm\A7B10.o(.data);
        A7B90 = .;
        build\asm\A7B90.o(.data);
        A7C10 = .;
        build\asm\A7C10.o(.data);
        A7C70 = .;
        build\asm\A7C70.o(.data);
        A7D50 = .;
        build\asm\A7D50.o(.data);
        A7E10 = .;
        build\asm\A7E10.o(.data);
        A8410 = .;
        build\asm\A8410.o(.data);
        A8440 = .;
        build\asm\A8440.o(.data);
        A8460 = .;
        build\asm\A8460.o(.data);
        A87F0 = .;
        build\asm\A87F0.o(.data);
        A8900 = .;
        build\asm\A8900.o(.data);
        A8A20 = .;
        build\asm\A8A20.o(.data);
        A8B00 = .;
        build\asm\A8B00.o(.data);
        A8CE0 = .;
        build\asm\A8CE0.o(.data);
        A9080 = .;
        build\asm\A9080.o(.data);
        A9550 = .;
        build\asm\A9550.o(.data);
        A9860 = .;
        build\asm\A9860.o(.data);
        A9A10 = .;
        build\asm\A9A10.o(.data);
        A9D20 = .;
        build\asm\A9D20.o(.data);
        AA700 = .;
        build\asm\AA700.o(.data);
        AB380 = .;
        build\asm\AB380.o(.data);
        AB440 = .;
        build\asm\AB440.o(.data);
        AB520 = .;
        build\asm\AB520.o(.data);
        AB610 = .;
        build\asm\AB610.o(.data);
        AB990 = .;
        build\asm\AB990.o(.data);
        ABB00 = .;
        build\asm\ABB00.o(.data);
        ABC50 = .;
        build\asm\ABC50.o(.data);
        ABE20 = .;
        build\asm\ABE20.o(.data);
        ABE30 = .;
        build\asm\ABE30.o(.data);
        ABE50 = .;
        build\asm\ABE50.o(.data);
        AE340 = .;
        build\asm\AE340.o(.data);
        AE7D0 = .;
        build\asm\AE7D0.o(.data);
        AE8A0 = .;
        build\asm\AE8A0.o(.data);
        AE9A0 = .;
        build\asm\AE9A0.o(.data);
        AEA90 = .;
        build\asm\AEA90.o(.data);
        AEB70 = .;
        build\asm\AEB70.o(.data);
        AEED0 = .;
        build\asm\AEED0.o(.data);
        AEF70 = .;
        build\asm\AEF70.o(.data);
        AF0C0 = .;
        build\asm\AF0C0.o(.data);
        AF1A0 = .;
        build\asm\AF1A0.o(.data);
        AF2A0 = .;
        build\asm\AF2A0.o(.data);
        AFEE0 = .;
        build\asm\AFEE0.o(.data);
        B0110 = .;
        build\asm\B0110.o(.data);
        B2BF0 = .;
        build\asm\B2BF0.o(.data);
        B2DD0 = .;
        build\asm\B2DD0.o(.data);
        B2E20 = .;
        build\asm\B2E20.o(.data);
        B3340 = .;
        build\asm\B3340.o(.data);
        B3660 = .;
        build\asm\B3660.o(.data);
        B39A0 = .;
        build\asm\B39A0.o(.data);
        B3BE0 = .;
        build\asm\B3BE0.o(.data);
        B3E60 = .;
        build\asm\B3E60.o(.data);
        B5510 = .;
        build\asm\B5510.o(.data);
        B5600 = .;
        build\asm\B5600.o(.data);
        B56B0 = .;
        build\asm\B56B0.o(.data);
        B6010 = .;
        build\asm\B6010.o(.data);
        B6130 = .;
        build\asm\B6130.o(.data);
        B6180 = .;
        build\asm\B6180.o(.data);
        B61F0 = .;
        build\asm\B61F0.o(.data);
        B62A0 = .;
        build\asm\B62A0.o(.data);
        B6380 = .;
        build\asm\B6380.o(.data);
        B63E0 = .;
        build\asm\B63E0.o(.data);
        B6440 = .;
        build\asm\B6440.o(.data);
        B6500 = .;
        build\asm\B6500.o(.data);
        B6590 = .;
        build\asm\B6590.o(.data);
        B7280 = .;
        build\asm\B7280.o(.data);
        B7DF0 = .;
        build\asm\B7DF0.o(.data);
        B7E10 = .;
        build\asm\B7E10.o(.data);
        B8850 = .;
        build\asm\B8850.o(.data);
        B8900 = .;
        build\asm\B8900.o(.data);
        B9B90 = .;
        build\asm\B9B90.o(.data);
        B9EC0 = .;
        build\asm\B9EC0.o(.data);
        BB260 = .;
        build\asm\BB260.o(.data);
        BB310 = .;
        build\asm\BB310.o(.data);
        BB3F0 = .;
        build\asm\BB3F0.o(.data);
        BB5E0 = .;
        build\asm\BB5E0.o(.data);
        . = ALIGN(., 16);
        main_DATA_END = .;
        main_DATA_SIZE = ABSOLUTE(main_DATA_END - main_DATA_START);
        main_RODATA_START = .;
        build\asm\1050.o(.rodata);
        build\asm\5A70.o(.rodata);
        build\asm\A540.o(.rodata);
        build\asm\11820.o(.rodata);
        build\asm\12DD0.o(.rodata);
        build\asm\134E0.o(.rodata);
        build\asm\13850.o(.rodata);
        build\asm\156F0.o(.rodata);
        build\asm\17A70.o(.rodata);
        build\asm\1E7A0.o(.rodata);
        build\asm\1F1E0.o(.rodata);
        build\asm\22290.o(.rodata);
        build\asm\241E0.o(.rodata);
        build\asm\438E0.o(.rodata);
        build\asm\48A30.o(.rodata);
        build\asm\49200.o(.rodata);
        build\asm\4FEB0.o(.rodata);
        build\asm\59EA0.o(.rodata);
        build\asm\5D120.o(.rodata);
        build\asm\5E230.o(.rodata);
        build\asm\60CF0.o(.rodata);
        build\asm\61B80.o(.rodata);
        build\asm\66250.o(.rodata);
        build\asm\7D8E0.o(.rodata);
        build\asm\805E0.o(.rodata);
        build\asm\80D90.o(.rodata);
        build\asm\82920.o(.rodata);
        build\asm\82DB0.o(.rodata);
        build\asm\82F80.o(.rodata);
        build\asm\844E0.o(.rodata);
        build\asm\84BB0.o(.rodata);
        build\asm\8D0A0.o(.rodata);
        build\asm\8F080.o(.rodata);
        build\asm\97770.o(.rodata);
        build\asm\99750.o(.rodata);
        build\asm\99A70.o(.rodata);
        build\asm\99B50.o(.rodata);
        build\asm\9A3C0.o(.rodata);
        build\asm\9A820.o(.rodata);
        build\asm\9A8F0.o(.rodata);
        build\asm\9AC20.o(.rodata);
        build\asm\9B060.o(.rodata);
        build\asm\9B250.o(.rodata);
        build\asm\9B2F0.o(.rodata);
        build\asm\9B5B0.o(.rodata);
        build\asm\9B680.o(.rodata);
        build\asm\9BAA0.o(.rodata);
        build\asm\9BAD0.o(.rodata);
        build\asm\9C5D0.o(.rodata);
        build\asm\9C620.o(.rodata);
        build\asm\9C730.o(.rodata);
        build\asm\9C880.o(.rodata);
        build\asm\9C8E0.o(.rodata);
        build\asm\9CD50.o(.rodata);
        build\asm\9D020.o(.rodata);
        build\asm\9EEA0.o(.rodata);
        build\asm\9EEF0.o(.rodata);
        build\asm\9F0D0.o(.rodata);
        build\asm\9F140.o(.rodata);
        build\asm\9FA70.o(.rodata);
        build\asm\9FA90.o(.rodata);
        build\asm\A09A0.o(.rodata);
        build\asm\A09F0.o(.rodata);
        build\asm\A0B40.o(.rodata);
        build\asm\A0BF0.o(.rodata);
        build\asm\A0C60.o(.rodata);
        build\asm\A4D70.o(.rodata);
        build\asm\A4DB0.o(.rodata);
        build\asm\A4E80.o(.rodata);
        build\asm\A51F0.o(.rodata);
        build\asm\A5270.o(.rodata);
        build\asm\A53C0.o(.rodata);
        build\asm\A5510.o(.rodata);
        build\asm\A5810.o(.rodata);
        build\asm\A59F0.o(.rodata);
        build\asm\A5AA0.o(.rodata);
        build\asm\A5D10.o(.rodata);
        build\asm\A5DD0.o(.rodata);
        build\asm\A6240.o(.rodata);
        build\asm\A6310.o(.rodata);
        build\asm\A6320.o(.rodata);
        build\asm\A63F0.o(.rodata);
        build\asm\A6830.o(.rodata);
        build\asm\A6930.o(.rodata);
        build\asm\A6A90.o(.rodata);
        build\asm\A6AD0.o(.rodata);
        build\asm\A79B0.o(.rodata);
        build\asm\A7A80.o(.rodata);
        build\asm\A7B10.o(.rodata);
        build\asm\A7B90.o(.rodata);
        build\asm\A7C10.o(.rodata);
        build\asm\A7C70.o(.rodata);
        build\asm\A7D50.o(.rodata);
        build\asm\A7E10.o(.rodata);
        build\asm\A8410.o(.rodata);
        build\asm\A8440.o(.rodata);
        build\asm\A8460.o(.rodata);
        build\asm\A87F0.o(.rodata);
        build\asm\A8900.o(.rodata);
        build\asm\A8A20.o(.rodata);
        build\asm\A8B00.o(.rodata);
        build\asm\A8CE0.o(.rodata);
        build\asm\A9080.o(.rodata);
        build\asm\A9550.o(.rodata);
        build\asm\A9860.o(.rodata);
        build\asm\A9A10.o(.rodata);
        build\asm\A9D20.o(.rodata);
        build\asm\AA700.o(.rodata);
        build\asm\AB380.o(.rodata);
        build\asm\AB440.o(.rodata);
        build\asm\AB520.o(.rodata);
        build\asm\AB610.o(.rodata);
        build\asm\AB990.o(.rodata);
        build\asm\ABB00.o(.rodata);
        build\asm\ABC50.o(.rodata);
        build\asm\ABE20.o(.rodata);
        build\asm\ABE30.o(.rodata);
        build\asm\ABE50.o(.rodata);
        build\asm\AE340.o(.rodata);
        build\asm\AE7D0.o(.rodata);
        build\asm\AE8A0.o(.rodata);
        build\asm\AE9A0.o(.rodata);
        build\asm\AEA90.o(.rodata);
        build\asm\AEB70.o(.rodata);
        build\asm\AEED0.o(.rodata);
        build\asm\AEF70.o(.rodata);
        build\asm\AF0C0.o(.rodata);
        build\asm\AF1A0.o(.rodata);
        build\asm\AF2A0.o(.rodata);
        build\asm\AFEE0.o(.rodata);
        build\asm\B0110.o(.rodata);
        build\asm\B2BF0.o(.rodata);
        build\asm\B2DD0.o(.rodata);
        build\asm\B2E20.o(.rodata);
        build\asm\B3340.o(.rodata);
        build\asm\B3660.o(.rodata);
        build\asm\B39A0.o(.rodata);
        build\asm\B3BE0.o(.rodata);
        build\asm\B3E60.o(.rodata);
        build\asm\B5510.o(.rodata);
        build\asm\B5600.o(.rodata);
        build\asm\B56B0.o(.rodata);
        build\asm\B6010.o(.rodata);
        build\asm\B6130.o(.rodata);
        build\asm\B6180.o(.rodata);
        build\asm\B61F0.o(.rodata);
        build\asm\B62A0.o(.rodata);
        build\asm\B6380.o(.rodata);
        build\asm\B63E0.o(.rodata);
        build\asm\B6440.o(.rodata);
        build\asm\B6500.o(.rodata);
        build\asm\B6590.o(.rodata);
        build\asm\B7280.o(.rodata);
        build\asm\B7DF0.o(.rodata);
        build\asm\B7E10.o(.rodata);
        build\asm\B8850.o(.rodata);
        build\asm\B8900.o(.rodata);
        build\asm\B9B90.o(.rodata);
        build\asm\B9EC0.o(.rodata);
        build\asm\BB260.o(.rodata);
        build\asm\BB310.o(.rodata);
        build\asm\BB3F0.o(.rodata);
        build\asm\BB5E0.o(.rodata);
        build\asm\data\_may_.rodata.o(.rodata);
        . = ALIGN(., 16);
        main_RODATA_END = .;
        main_RODATA_SIZE = ABSOLUTE(main_RODATA_END - main_RODATA_START);
    }
    main_bss_VRAM = ADDR(.main_bss);
    .main_bss (NOLOAD) : SUBALIGN(16)
    {
        FILL(0x00000000);
        main_BSS_START = .;
        build\asm\1050.o(.bss);
        build\asm\5A70.o(.bss);
        build\asm\A540.o(.bss);
        build\asm\11820.o(.bss);
        build\asm\12DD0.o(.bss);
        build\asm\134E0.o(.bss);
        build\asm\13850.o(.bss);
        build\asm\156F0.o(.bss);
        build\asm\17A70.o(.bss);
        build\asm\1E7A0.o(.bss);
        build\asm\1F1E0.o(.bss);
        build\asm\22290.o(.bss);
        build\asm\241E0.o(.bss);
        build\asm\438E0.o(.bss);
        build\asm\48A30.o(.bss);
        build\asm\49200.o(.bss);
        build\asm\4FEB0.o(.bss);
        build\asm\59EA0.o(.bss);
        build\asm\5D120.o(.bss);
        build\asm\5E230.o(.bss);
        build\asm\60CF0.o(.bss);
        build\asm\61B80.o(.bss);
        build\asm\66250.o(.bss);
        build\asm\7D8E0.o(.bss);
        build\asm\805E0.o(.bss);
        build\asm\80D90.o(.bss);
        build\asm\82920.o(.bss);
        build\asm\82DB0.o(.bss);
        build\asm\82F80.o(.bss);
        build\asm\844E0.o(.bss);
        build\asm\84BB0.o(.bss);
        build\asm\8D0A0.o(.bss);
        build\asm\8F080.o(.bss);
        build\asm\97770.o(.bss);
        build\asm\99750.o(.bss);
        build\asm\99A70.o(.bss);
        build\asm\99B50.o(.bss);
        build\asm\9A3C0.o(.bss);
        build\asm\9A820.o(.bss);
        build\asm\9A8F0.o(.bss);
        build\asm\9AC20.o(.bss);
        build\asm\9B060.o(.bss);
        build\asm\9B250.o(.bss);
        build\asm\9B2F0.o(.bss);
        build\asm\9B5B0.o(.bss);
        build\asm\9B680.o(.bss);
        build\asm\9BAA0.o(.bss);
        build\asm\9BAD0.o(.bss);
        build\asm\9C5D0.o(.bss);
        build\asm\9C620.o(.bss);
        build\asm\9C730.o(.bss);
        build\asm\9C880.o(.bss);
        build\asm\9C8E0.o(.bss);
        build\asm\9CD50.o(.bss);
        build\asm\9D020.o(.bss);
        build\asm\9EEA0.o(.bss);
        build\asm\9EEF0.o(.bss);
        build\asm\9F0D0.o(.bss);
        build\asm\9F140.o(.bss);
        build\asm\9FA70.o(.bss);
        build\asm\9FA90.o(.bss);
        build\asm\A09A0.o(.bss);
        build\asm\A09F0.o(.bss);
        build\asm\A0B40.o(.bss);
        build\asm\A0BF0.o(.bss);
        build\asm\A0C60.o(.bss);
        build\asm\A4D70.o(.bss);
        build\asm\A4DB0.o(.bss);
        build\asm\A4E80.o(.bss);
        build\asm\A51F0.o(.bss);
        build\asm\A5270.o(.bss);
        build\asm\A53C0.o(.bss);
        build\asm\A5510.o(.bss);
        build\asm\A5810.o(.bss);
        build\asm\A59F0.o(.bss);
        build\asm\A5AA0.o(.bss);
        build\asm\A5D10.o(.bss);
        build\asm\A5DD0.o(.bss);
        build\asm\A6240.o(.bss);
        build\asm\A6310.o(.bss);
        build\asm\A6320.o(.bss);
        build\asm\A63F0.o(.bss);
        build\asm\A6830.o(.bss);
        build\asm\A6930.o(.bss);
        build\asm\A6A90.o(.bss);
        build\asm\A6AD0.o(.bss);
        build\asm\A79B0.o(.bss);
        build\asm\A7A80.o(.bss);
        build\asm\A7B10.o(.bss);
        build\asm\A7B90.o(.bss);
        build\asm\A7C10.o(.bss);
        build\asm\A7C70.o(.bss);
        build\asm\A7D50.o(.bss);
        build\asm\A7E10.o(.bss);
        build\asm\A8410.o(.bss);
        build\asm\A8440.o(.bss);
        build\asm\A8460.o(.bss);
        build\asm\A87F0.o(.bss);
        build\asm\A8900.o(.bss);
        build\asm\A8A20.o(.bss);
        build\asm\A8B00.o(.bss);
        build\asm\A8CE0.o(.bss);
        build\asm\A9080.o(.bss);
        build\asm\A9550.o(.bss);
        build\asm\A9860.o(.bss);
        build\asm\A9A10.o(.bss);
        build\asm\A9D20.o(.bss);
        build\asm\AA700.o(.bss);
        build\asm\AB380.o(.bss);
        build\asm\AB440.o(.bss);
        build\asm\AB520.o(.bss);
        build\asm\AB610.o(.bss);
        build\asm\AB990.o(.bss);
        build\asm\ABB00.o(.bss);
        build\asm\ABC50.o(.bss);
        build\asm\ABE20.o(.bss);
        build\asm\ABE30.o(.bss);
        build\asm\ABE50.o(.bss);
        build\asm\AE340.o(.bss);
        build\asm\AE7D0.o(.bss);
        build\asm\AE8A0.o(.bss);
        build\asm\AE9A0.o(.bss);
        build\asm\AEA90.o(.bss);
        build\asm\AEB70.o(.bss);
        build\asm\AEED0.o(.bss);
        build\asm\AEF70.o(.bss);
        build\asm\AF0C0.o(.bss);
        build\asm\AF1A0.o(.bss);
        build\asm\AF2A0.o(.bss);
        build\asm\AFEE0.o(.bss);
        build\asm\B0110.o(.bss);
        build\asm\B2BF0.o(.bss);
        build\asm\B2DD0.o(.bss);
        build\asm\B2E20.o(.bss);
        build\asm\B3340.o(.bss);
        build\asm\B3660.o(.bss);
        build\asm\B39A0.o(.bss);
        build\asm\B3BE0.o(.bss);
        build\asm\B3E60.o(.bss);
        build\asm\B5510.o(.bss);
        build\asm\B5600.o(.bss);
        build\asm\B56B0.o(.bss);
        build\asm\B6010.o(.bss);
        build\asm\B6130.o(.bss);
        build\asm\B6180.o(.bss);
        build\asm\B61F0.o(.bss);
        build\asm\B62A0.o(.bss);
        build\asm\B6380.o(.bss);
        build\asm\B63E0.o(.bss);
        build\asm\B6440.o(.bss);
        build\asm\B6500.o(.bss);
        build\asm\B6590.o(.bss);
        build\asm\B7280.o(.bss);
        build\asm\B7DF0.o(.bss);
        build\asm\B7E10.o(.bss);
        build\asm\B8850.o(.bss);
        build\asm\B8900.o(.bss);
        build\asm\B9B90.o(.bss);
        build\asm\B9EC0.o(.bss);
        build\asm\BB260.o(.bss);
        build\asm\BB310.o(.bss);
        build\asm\BB3F0.o(.bss);
        build\asm\BB5E0.o(.bss);
        build\asm\data\F00D0.bss.o(.bss);
        . = ALIGN(., 16);
        main_BSS_END = .;
        main_BSS_SIZE = ABSOLUTE(main_BSS_END - main_BSS_START);
    }
    __romPos += SIZEOF(.main);
    __romPos = ALIGN(__romPos, 16);
    . = ALIGN(., 16);
    main_ROM_END = __romPos;
    main_VRAM_END = .;

    F00D0_ROM_START = __romPos;
    F00D0_VRAM = ADDR(.F00D0);
    .F00D0 main_VRAM_END : AT(F00D0_ROM_START) SUBALIGN(16)
    {
        FILL(0x00000000);
        F00D0_DATA_START = .;
        F00D0 = .;
        build\assets\F00D0.o(.data);
        F00D0_DATA_END = .;
        F00D0_DATA_SIZE = ABSOLUTE(F00D0_DATA_END - F00D0_DATA_START);
    }
    __romPos += SIZEOF(.F00D0);
    F00D0_ROM_END = __romPos;
    F00D0_VRAM_END = .;

    /DISCARD/ :
    {
        *(*);
    }
}
